## boards/shields/adl_k/Kconfig.defconfig
```kconfig
if SHIELD_ADL_K

config ZMK_KEYBOARD_NAME
    default "adl'k"

endif # SHIELD_ADL_K
```

## boards/shields/cadpad/Kconfig.defconfig
```kconfig
if SHIELD_CADPAD

config ZMK_KEYBOARD_NAME
    default "CadPad"

endif # SHIELD_CADPAD
```
